// SPDX-License-Identifier: (GPL-2.0+ OR MIT)
/*
 * Copyright (c) 2020 Rockchip Electronics Co., Ltd.
 *
 */

#include "rk3568-evb1-ddr4-v10.dtsi"
#include "rk3568-android.dtsi"

/ {
	model = "RK3568 BTS";
	compatible = "rockchip,rk3568-bts", "rockchip,rk3568";
